## arch/arm/mach-tegra/microsoft-surface-rt/Kconfig
```kconfig
config MACH_SURFACE_RT
       bool "surface rt board"
       depends on ARCH_TEGRA_3x_SOC
       help
         Support for Microsoft Surface RT
```

## drivers/bluetooth/mbtc/Kconfig
```kconfig
config MBT_SD_CHAR
	tristate "Marvell Bluetooth SD Char driver"
	help
	  This driver supports Marvell Bluetooth SD8797 device.

	  Say Y here to compile Marvell Bluetooth SD Char driver
	  into the kernel or say M to compile it as module (mbt8xxx).

config ATHOME_BT_REMOTE
	boolean "Support athome remote"
	depends on MBT_SD_CHAR
	help
	  Enabling this puts in the splitter that allows BT to
	  function as before, while splitting off remote traffic
	  to a separate device.
```

## drivers/hid/i2c-hid/Kconfig
```kconfig
# SPDX-License-Identifier: GPL-2.0-only
menu "I2C HID support"
	depends on I2C

config I2C_HID_CORE
	tristate "HID over I2C transport layer driver"
	default n
	depends on I2C && INPUT
	help
	  Say Y here if you use a keyboard, a touchpad, a touchscreen, or any
	  other HID based devices which is connected to your computer via I2C.

	  If unsure, say N.

	  This support is also available as a module.  If so, the module
	  will be called i2c-hid-of.  It will also build/depend on the
	  module i2c-hid.

endmenu
```

## drivers/net/wireless/mwlan/Kconfig
```kconfig
config MWLAN
	tristate "Marvell MLAN Driver"
	depends on CFG80211
	---help---
	  This adds support for wireless adapters based on Marvell
	  MLAN chipsets.
```

## drivers/net/wireless/sd8xxx/Kconfig
```kconfig
config SD8797_AOSP
	tristate "Marvell WiFi-Ex Driver for Android SD8797"
	depends on CFG80211
	select LIB80211
	---help---
	  Help Marvell WiFi-Ex Driver for Android SD8797 wlan.ko

config SD8797_AOSP_SDIO
	tristate "Marvell WiFi-Ex Driver for Android SD8797_SDIO"
	depends on SD8797_AOSP && MMC
	select FW_LOADER
	---help---
	  This adds support for wireless adapters based on Marvell
	  8787/8797 chipsets with SDIO interface.

	  If you choose to build it as a module, it will be called
	  sd8xxx.ko
```
